## src/Kconfig.projbuild
```kconfig
menu "Printer server"

    config PRINTER_DRIVER
        string "Printer driver"
        default "canon-mg2500"
        help
            The id of the printer model the firmware drives until a printer
            is plugged in, and for a printer it does not recognise, from
            components/printers/printers.c. A recognised printer (USB id or
            IEEE 1284 model name) uses its own driver.

    choice PRINTER_RESOLUTION
        prompt "Test page resolution"
        default PRINTER_RES_600
        help
            Canon plain-paper print mode used for the test page.
        config PRINTER_RES_300
            bool "300x300 dpi (fast, CMYK 1 bit)"
        config PRINTER_RES_600
            bool "600x600 dpi (standard, C/M 3-level)"
    endchoice

    config STATUS_LED_GPIO
        int "WS2812 status LED GPIO"
        default 48

    config STATUS_LED_BRIGHTNESS
        int "Status LED brightness (percent)"
        range 1 100
        default 10

    config PRINT_BUTTON_GPIO
        int "Print button GPIO (active low)"
        default 0

    config PRINT_BUTTON2_GPIO
        int "Second print button GPIO (same as BOOT, active low, -1 = none)"
        default 4

    config USER_BUTTON_GPIO
        int "User button GPIO (no action assigned: on_user_button in main.c; active low, -1 = none)"
        default 5

    config WIFI_SETUP_AFTER_MIN
        int "Open the WiFi setup network after this many minutes without WiFi (0 = never)"
        range 0 1440
        default 5
        help
            When the saved network does not answer for this long (another
            router, a new password), the board restarts into its setup
            network "Printer-Setup-XXXX" to choose again. It keeps trying the
            saved network meanwhile and restarts when it is back. Only when
            SETUP_PASSWORD (.env) protects the setup network: an open one
            would let anyone who keeps the board off its network point it at
            theirs. Without it, hold BOOT 10 s to choose again.

    config OLED_SDA_GPIO
        int "Status screen (I2C OLED) SDA GPIO"
        default 42

    config OLED_SCL_GPIO
        int "Status screen (I2C OLED) SCL GPIO"
        default 41

    choice OLED_CONTROLLER
        prompt "Status screen controller"
        default OLED_SSD1306
        help
            0.96" 128x64 modules are usually SSD1306, 1.3" ones SH1106
            (on an SSD1306 setting, an SH1106 shows a 2-pixel column of
            noise at one edge).
        config OLED_SSD1306
            bool "SSD1306"
        config OLED_SH1106
            bool "SH1106"
    endchoice

    config OLED_FLIP
        bool "Rotate the status screen by 180 degrees"
        default n

    config OLED_SLEEP_MIN
        int "Turn the status screen off after this many minutes without change (0 = never)"
        range 0 1440
        default 10
        help
            OLED pixels that stay lit for months burn in. Any change on the
            screen or a press of the button turns it back on.

endmenu
```
